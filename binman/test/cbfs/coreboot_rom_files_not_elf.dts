// SPDX-License-Identifier: GPL-2.0+

/dts-v1/;

/ {
	#address-cells = <1>;
	#size-cells = <1>;

	binman {
		coreboot-rom {
			coreboot-filename = "cbrom-big.rom";
			payload {
				type = "text";
				text = "not-an-elf";
				cbfs-name = "fallback/payload";
				cbfs-type = "payload";
			};
		};
	};
};
