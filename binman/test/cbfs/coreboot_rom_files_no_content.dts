// SPDX-License-Identifier: GPL-2.0+

/dts-v1/;

/ {
	#address-cells = <1>;
	#size-cells = <1>;

	binman {
		coreboot-rom {
			coreboot-filename = "cbrom-big.rom";
			imagename {
				type = "_testing";
				return-unknown-contents;
				cbfs-name = "img/unknown";
			};
		};
	};
};
